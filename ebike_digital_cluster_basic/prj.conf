## CMakeLists.txt
```
# SPDX-License-Identifier: Apache-2.0

cmake_minimum_required(VERSION 3.20.0)

find_package(Zephyr REQUIRED HINTS $ENV{ZEPHYR_BASE})
project(ebike)

target_include_directories(app PRIVATE
    src
    src/generated
    src/custom
    src/generated/guider_customer_fonts
    src/generated/guider_fonts
    src/generated/images
)

FILE(GLOB app_sources
	src/*.c
	src/custom/*.c
	src/generated/*.c
	src/generated/images/*.c
	src/generated/guider_fonts/*.c
	src/generated/guider_customer_fonts/*.c)
target_sources(app PRIVATE ${app_sources})
```

## Kconfig
```
# Copyright 2025 NXP
# SPDX-License-Identifier: Apache-2.0

source "Kconfig.zephyr"

mainmenu "eBike Digital Cluster Basic Demo"
```

## prj.conf
```kconfig
CONFIG_LV_Z_MEM_POOL_SIZE=163840
CONFIG_LV_Z_SHELL=y
CONFIG_MAIN_STACK_SIZE=16384

CONFIG_DISPLAY=y

CONFIG_LOG=y
CONFIG_SHELL=y

CONFIG_LVGL=y
CONFIG_LV_USE_LOG=y
CONFIG_LV_USE_LABEL=y
CONFIG_LV_USE_ARC=y
CONFIG_LV_USE_MONKEY=y
CONFIG_LV_FONT_MONTSERRAT_14=y
```

## src/main.c
```c
/*
 * Copyright 2025 NXP
 *
 * SPDX-License-Identifier: Apache-2.0
 */

#include <zephyr/device.h>
#include <zephyr/devicetree.h>
#include <zephyr/drivers/display.h>
#include <lvgl.h>
#include <stdio.h>
#include <string.h>
#include <zephyr/kernel.h>
#include "gui_guider.h"
#include "custom.h"
#include "events_init.h"

#define LOG_LEVEL CONFIG_LOG_DEFAULT_LEVEL
#include <zephyr/logging/log.h>
LOG_MODULE_REGISTER(app);

lv_ui guider_ui;

int main(void)
{
	const struct device *display_dev;

	display_dev = DEVICE_DT_GET(DT_CHOSEN(zephyr_display));
	if (!device_is_ready(display_dev)) {
		LOG_ERR("Device not ready, aborting test");
		return 0;
	}
	LOG_INF("ebike lvgl demo");

	lv_timer_handler();
	display_blanking_off(display_dev);

	setup_ui(&guider_ui);
	events_init(&guider_ui);
	custom_init(&guider_ui);

	while (1) {
		lv_timer_handler();
		k_sleep(K_MSEC(10));
	}
}
```
